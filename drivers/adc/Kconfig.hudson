## drivers/adc/Kconfig.hudson
```kconfig
config ADC_HUDSON
	bool "HUDSON ADC driver"
	default y
	depends on DT_HAS_ADI_HUDSON_ADC_ENABLED
	select I2c
	help
	  Enable the HUDSON ADC driver.

config ADC_HUDSON_THREAD_STACK_SIZE
	int "Stack size for the ADC data acquisition thread"
	depends on ADC_HUDSON
	default 512
	help
	  Size of the stack used for the internal data acquisition
	  thread.

config ADC_HUDSON_THREAD_PRIO
	int "Priority for the ADC data acquisition thread"
	depends on ADC_HUDSON
	default 0
	help
	  Priority level for the internal ADC data acquisition thread.
```

## drivers/fuel_gauge/hudson_gauge/Kconfig
```kconfig
config FUEL_GAUGE_HUDSON
	bool "Hudson fuel gauge"
	default y
	depends on DT_HAS_ADI_HUDSON_FUEL_GAUGE_ENABLED
	depends on ADC_HUDSON
	help
	  Enable driver for the hudson fuel gauge device.

config EMUL_HUDSON_GAUGE
	bool "Emulate hudson fuel gague"
	default y
	depends on EMUL
	depends on FUEL_GAUGE_HUDSON
	help
	  It provides read/write emulations for the fuel gauge
```

## drivers/regulator/Kconfig.hudson
```kconfig
# Copyright (c) 2025, Analog Devices
# SPDX-License-Identifier: Apache-2.0

config REGULATOR_HUDSON
	bool "Analog Devices HUDSON PMIC driver"
	default y
	depends on DT_HAS_ADI_HUDSON_PMIC_ENABLED
	depends on I2C
	help
	  Enable the ADI HUDSON PMIC driver

config REGULATOR_HUDSON_INIT_PRIORITY
	int "Analog Devices HUDSON PMIC peripehral driver init priority"
	default 60
	depends on DT_HAS_ADI_HUDSON_PMIC_ENABLED
	help
	  Init priority for the Analog Devices HUDSON PMIC peripehral.
```

## dts/bindings/adc/adi,hudson-adc.yaml
```yaml
include: [adc-controller.yaml, i2c-device.yaml]

compatible: "adi,hudson-adc"

description: Binding for the ADI HUDSON ADC.

properties:
  vref-mv:
    type: int
    description: |
      The reference voltage in millivolts. This is used to calculate the
      conversion value from the raw ADC value.

io-channel-cells:
  - input
```

## dts/bindings/fuel-gauge/adi,hudson-fuel-gauge.yaml
```yaml
include: [i2c-device.yaml, fuel-gauge.yaml, sensor-device.yaml]

compatible: "adi,hudson-fuel-gauge"

description: |
  ADI Hudson Fuel Gauge with

properties:
  adc:
    type: phandle
    description: |
      The ADC used to read the fuel gauge voltage. This is used to calculate
      the fuel gauge voltage from the raw ADC value.
    required: true

  io-channels:
    type: phandle-array
    required: true
    description: |
      The ADC channels used to read multiple fuel gauge properties

  io-channels-names:
    type: string-array
    required: true
    description: |
      The labels associated with the ADC channels
```

## dts/bindings/regulator/adi,hudson.yaml
```yaml
# Copyright (c), 2025 Analog Devices
# SPDX-License-Identifier: Apache-2.0

description: |
  Analog Devices HUDSON PMIC

  The PMIC has three buck converters and four LDOs

  Example:

  pmic@46 {
      compatible = "adi,hudson-pmic"
      reg = <0x46>;

      		buck0: buck0 {
      			status = "okay";
      			adi,turn-on-delay-us = <100>;
      			adi,turn-off-delay-us = <100>;
      			adi,rok-delay-us = <50>;
      			adi,trim-ilr = <2>;
      			adi,trim-vreg = <4>;
      		};


      		ldo0: ldo0 {
      			status = "okay";
      			adi,turn-on-delay-us = <50>;
      			adi,turn-off-delay-us = <50>;
      		};

          ...

      };
  };

compatible: "adi,hudson-pmic"

include: base.yaml

child-binding:
  include:
    - name: regulator.yaml
      property-allowlist:
        - regulator-always-on
        - regulator-boot-on
        - regulator-boot-off
        - regulator-min-microvolt
        - regulator-max-microvolt
        - regulator-allowed-modes
        - regulator-initial-mode

  properties:
    adi,turn-on-delay-us:
      type: int
      description: |
        Configurable Delays for Turn-on Sequence. Delays
        the assertion of the enable signal during turn-on sequence.
        Supports 0-50ms with time resolution of ~100us.

    adi,turn-off-delay-us:
      type: int
      description: |
        Configurable Delays for Turn-off Sequence.
        Delays the de-assertion of the enable signal during turn-
        off sequence.
        Supports 0-50ms with time resolution of ~100us.

    adi,rok-delay-us:
      type: int
      description: |
        Delay Parameters for ROK Signal. It represents the delay between
        the enable assertion and rising edge of ROK.
        Supports 0-10ms with time resolution of ~100us.

    adi,trim-ilr:
      type: int
      description: |
        Inductor Current Ripple Trim. 3-bit control to trim inductor current ripple.

    adi,trim-vreg:
      type: int
      description: |
        Output Voltage Trim. 5-bit control to trim the output voltage.
```

## tests/drivers/fuel_gauge/hudson/testcase.yaml
```yaml
tests:
  drivers.fuel_gauge.hudson_fuel_gauge:
    tags:
      - drivers
      - fuel_gauge
    filter: dt_compat_enabled("adi,hudson-fuel-gauge")
    platform_allow:
      - native_sim
      - qemu_cortex_m0
```
